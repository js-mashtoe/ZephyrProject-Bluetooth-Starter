## CMakeLists.txt
```
# SPDX-License-Identifier: Apache-2.0

cmake_minimum_required(VERSION 3.13.1)

include($ENV{ZEPHYR_BASE}/cmake/app/boilerplate.cmake NO_POLICY_SCOPE)
project(starter)

include_directories(app PRIVATE inc)

FILE(GLOB app_sources src/*.c)
target_sources(app PRIVATE
  ${app_sources}
  )

# zephyr_compile_options(-save-temps)
```

## prj.conf
```kconfig
CONFIG_DEBUG=y

#CONFIG_FLOAT=y
#CONFIG_FP_HARDABI=y
#CONFIG_FP_SHARING=y
#CONFIG_NEWLIB_LIBC=y
#CONFIG_NEWLIB_LIBC_FLOAT_PRINTF=y

CONFIG_BT=y
CONFIG_BT_DEBUG_LOG=y
CONFIG_BT_SMP=y
CONFIG_BT_PERIPHERAL=y
CONFIG_BT_GATT_DIS=y
CONFIG_BT_GATT_DIS_PNP=n
CONFIG_BT_GATT_BAS=y
CONFIG_BT_GATT_BAS_LOG_LEVEL=0
CONFIG_BT_DEVICE_NAME="Starter"
CONFIG_BT_DEVICE_APPEARANCE=128

CONFIG_BT_GATT_DIS=y
CONFIG_BT_GATT_DIS_PNP=n
CONFIG_BT_GATT_DIS_MODEL="Starter"
CONFIG_BT_GATT_DIS_MANUF="ABC_Manufacturing"
CONFIG_BT_GATT_DIS_SERIAL_NUMBER=y
CONFIG_BT_GATT_DIS_SERIAL_NUMBER_STR="Starter Serial"
CONFIG_BT_GATT_DIS_FW_REV=y
CONFIG_BT_GATT_DIS_HW_REV=y
CONFIG_BT_GATT_DIS_SW_REV=y
CONFIG_BT_GATT_DIS_FW_REV_STR="Starter Firmware"
CONFIG_BT_GATT_DIS_HW_REV_STR="Starter Hardware"
CONFIG_BT_GATT_DIS_SW_REV_STR="Starter Software"

CONFIG_USE_SEGGER_RTT=y
CONFIG_SEGGER_RTT_MAX_NUM_UP_BUFFERS=3
CONFIG_SEGGER_RTT_MAX_NUM_DOWN_BUFFERS=3
CONFIG_SEGGER_RTT_BUFFER_SIZE_UP=1024
CONFIG_SEGGER_RTT_BUFFER_SIZE_DOWN=16
CONFIG_SEGGER_RTT_PRINTF_BUFFER_SIZE=64
CONFIG_SEGGER_RTT_MODE_NO_BLOCK_SKIP=y
CONFIG_SEGGER_RTT_MODE=0

CONFIG_LOG_PRINTK=y
CONFIG_LOG_PRINTK_MAX_STRING_LENGTH=128
CONFIG_LOG_BACKEND_RTT=y

CONFIG_LOG_BACKEND_RTT_MODE_BLOCK=y
CONFIG_LOG_BACKEND_RTT_OUTPUT_BUFFER_SIZE=16
CONFIG_LOG_BACKEND_RTT_RETRY_CNT=4
CONFIG_LOG_BACKEND_RTT_RETRY_DELAY_MS=5
CONFIG_LOG_BACKEND_RTT_BUFFER=0
CONFIG_LOG_BACKEND_RTT_FORCE_PRINTK=y

CONFIG_LOG_BACKEND_SHOW_COLOR=n

#CONFIG_NRFX_TWI=y
#CONFIG_NRFX_TWI0=y
#CONFIG_I2C_0=y

# attempt to workaround missing label define 
#CONFIG_HAS_DTS_I2C=y

#CONFIG_I2C=y
#CONFIG_I2C_NRFX=y
#CONFIG_I2C_0_NRF_TWI=y
#CONFIG_I2C_INIT_PRIORITY=60
#CONFIG_I2C_LOG_LEVEL_INF=y
#CONFIG_I2C_LOG_LEVEL=3

#CONFIG_LIS2DH=y
#CONFIG_LIS2DH_TRIGGER_NONE=y
#CONFIG_LIS2DH_ACCEL_RANGE_RUNTIME=y
#CONFIG_LIS2DH_OPER_MODE_NORMAL=y
#CONFIG_LIS2DH_ODR_RUNTIME=y
```

## src/main.c
```c
/* 
 *  main.c - Application main entry point 
 */
#include <zephyr.h>
#include <misc/printk.h>

#include "ble_policy.h"

#define STACKSIZE 1024
#define PRIORITY 7
#define DELAY_TIME   K_MSEC(500)

/*---------------------------------------------------------------------------*/
/*                                                                           */
/*---------------------------------------------------------------------------*/
#if 1
#include "accel.h"

void accel_thread(void * id, void * unused1, void * unused2)
{
    printk("%s\n", __func__);

    k_sleep(DELAY_TIME);

    do {
        accel_init();
    } while(0);
}

K_THREAD_DEFINE(accel_id, STACKSIZE, accel_thread, 
                NULL, NULL, NULL, PRIORITY, 0, K_NO_WAIT);
#endif

/*---------------------------------------------------------------------------*/
/*  This kicks-off the BLE thread                                            */
/*---------------------------------------------------------------------------*/
#if 1
void bluetooth_thread(void * id, void * unused1, void * unused2)
{
    printk("%s\n", __func__);

    ble_policy_init();
}

K_THREAD_DEFINE(bluetooth_id, STACKSIZE, bluetooth_thread, NULL, NULL, NULL,
                PRIORITY, 0, K_NO_WAIT);
#endif
```

## inc/accel.h
```c
/*
 *  accel.h 
 */
#ifndef __ACCEL_H__
#define __ACCEL_H__

#include <stdio.h>
#include <drivers/sensor.h>

/*---------------------------------------------------------------------------*/
/*                                                                           */
/*---------------------------------------------------------------------------*/
void accel_init(void);
void accel_get_vector(struct sensor_value axis[3]);

#endif  /*__ACCEL_H__ */
```

## inc/accelerometer.h
```c
/*
 *  accelerometer.h 
 */
#ifndef __ACCELEROMETER_H__
#define __ACCELEROMETER_H__

/*---------------------------------------------------------------------------*/
/*                                                                           */
/*---------------------------------------------------------------------------*/
void accelerometer_init(void);

#endif  /*__ACCELEROMETER_H__ */
```

## inc/ble_base.h
```c
// ble_base.h 

#ifndef __BASE__H__
#define __BASE__H__

#include "ble_policy.h"
#include "ble_service.h"
#include "ble_uuids.h" 

bool is_connected(void);
void bas_notify(void);

int  ble_start_advertising(void);
int  ble_stop_advertising(void);
int  ble_disconnect(void);
int  ble_base_init(void);
#endif  // __BASE__H__
```

## inc/ble_policy.h
```c
/*
 *  ble_policy.h
 */
#ifndef __BLE_POLICY_H__
#define __BLE_POLICY_H__

#include "ble_base.h"

/*---------------------------------------------------------------------------*/
/*                                                                           */
/*---------------------------------------------------------------------------*/

typedef enum {
	BLE_EVENT__INVALID = 0,
	BLE_EVENT__COMMAND,
	BLE_EVENT__LAST
} ble_event_t;

typedef enum {
	BLE_CMD__INVALID = 0,
	BLE_CMD__DISCONNECT,
	BLE_CMD__CMD1,
	BLE_CMD__CMD2,  
	BLE_CMD__LAST
} ble_cmd_t;

/*---------------------------------------------------------------------------*/
/*                                                                           */
/*---------------------------------------------------------------------------*/
int  ble_enqueue_msg(ble_event_t charact, u32_t data);
void ble_operation_complete(ble_event_t charact, u32_t code);
void ble_policy_events(void);
int  ble_policy_init(void);
                   
#endif  // __BLE_POLICY_H__
```

## inc/ble_service.h
```c
/*
 *  app ble_service.h
 */
#ifndef __BLE_SERVICE_H__
#define __BLE_SERVICE_H__

int starter_notify(u32_t cmd, u32_t code);
                   
#endif  // __BLE_SERVICE_H__
```

## inc/ble_uuids.h
```c
/*
 *  app ble_uuids.h
 */
#ifndef __BLE_UUIDS_H__
#define __BLE_UUIDS_H__

/*
 *  The UUID was generated by the uuidgen utility, which gave
 *      aa9fa4b1-a1ee-457a-af5b-59a82163d898
 *      and hand reversed ...
 *      XYZ_UUID_BASE 0x63,0x21,0xA8,0x59,0x5B,0xAF,0x7A,0x45,0xEE,0xA1,0xB1,0xA4,0x9F,0xAA
 *
 *  The last two hex digits (0xd8, 0x98) were set to 0x00,0x00.
 *      aa9fa4b1-a1ee-457a-af5b-59a821630000
 *  This string was reversed to form a byte array to conform to 
 *  Zephyr's BLE API specifications.
 *      00006321a859-5baf-7a45-eea1-b1a49faa
 *
 *  UUID Base (common part) are the last 14 bytes of UUID.
 *  The first two bytes will be Service or Characteristic unique values.
 *  This is similar to the UUID16-type UUIDs specified by the BT SIG.
 */
#define STARTER_UUID_BASE 0x50,0x6B,0x75,0xCE,0xDD,0x9C,0x56,0x4B,0x87,0x70,0x32,0x10,0x60,0xCE 

#define STARTER_UUID_SERVICE            0x00,0x00
#define STARTER_UUID_NOTIFY             0x01,0x00
#define STARTER_UUID_COMMAND            0x02,0x00

/*
 *  Service UUID: aa9fa4b1-a1ee-457a-af5b-59a821630000
 */
#define BT_UUID_STARTER_SERVICE \
    BT_UUID_DECLARE_128(STARTER_UUID_SERVICE,STARTER_UUID_BASE)

/*
 *   Characteristics UUIDs: aa9fa4b1-a1ee-457a-af5b-59a82163xxxx
 */       

#define BT_UUID_STARTER_NOTIFY   \
    BT_UUID_DECLARE_128(STARTER_UUID_NOTIFY,STARTER_UUID_BASE)

#define BT_UUID_STARTER_COMMAND   \
    BT_UUID_DECLARE_128(STARTER_UUID_COMMAND,STARTER_UUID_BASE)

#endif  // __BLE_UUIDS_H__
```

## src/accel.c
```c
/*
 *   accel.c 
 */
#include <zephyr.h>
#include <stdio.h>
#include <device.h>
#include <misc/printk.h>

#include "accel.h"

#define MAX_TEST_TIME   10000
#define SLEEPTIME       500

extern uint8_t pbuf[1024];
extern uint8_t * pos;


static struct device * dev;

void accel_get_vector(struct sensor_value axis[3])
{
    if (!dev) {
        printk("dev == NULL\n");
        return;
    }

    if (sensor_sample_fetch(dev) < 0) {
        printk("ACCEL: Sample update error.\n");
        return;
    }

    if (sensor_channel_get(dev, SENSOR_CHAN_ACCEL_XYZ, axis) < 0) {
        printk("ACCEL: Cannot read accel channels.\n");
        return;
    }
}

#if !defined(CONFIG_LIS2DH12_TRIGGER)
void print_accel_data(struct device * dev)
{
    struct sensor_value val[3];

    if (sensor_channel_get(dev, SENSOR_CHAN_ACCEL_XYZ, val) < 0) {
        printk("ACCEL: Cannot read accel channels.\n");
        return;
    }
}

void test_polling_mode(struct device * dev)
{
    int32_t remaining_test_time = MAX_TEST_TIME;

    printk("ACCEL: test polling beginning\n");

    /* poll the data and print it */
    do {
        if (sensor_sample_fetch(dev) < 0) {
            printk("ACCEL: Sample update error.\n");
            return;
        }

        print_accel_data(dev);

        /* wait a while */
        k_sleep(SLEEPTIME);

        remaining_test_time -= SLEEPTIME;

    } while (remaining_test_time > 0);

    printk("ACCEL: test polling completed\n");
}
#endif // !defined(CONFIG_LIS3DH_TRIGGER)


#ifdef CONFIG_LIS3DH_TRIGGER
static void trigger_handler(struct device * dev,
                            struct sensor_trigger * trigger)
{
    if (trigger->type != SENSOR_TRIG_DELTA &&
        trigger->type != SENSOR_TRIG_DATA_READY) {
        return;
    }

    if (sensor_sample_fetch(dev) < 0) {
        printk("ACCEL: Sample update error.\n");
        return;
    }
}

static void test_anymotion_trigger(struct device * dev)
{
    int32_t remaining_test_time = MAX_TEST_TIME;
    struct sensor_trigger trig;

    /* set up anymotion trigger */

    printk("ACCEL: Anymotion test: shake the device to get anymotion events.\n");

    do {
        /* wait a while */
        k_sleep(SLEEPTIME);
        remaining_test_time -= SLEEPTIME;

    } while (remaining_test_time > 0);

    printk("ACCEL: Anymotion test: finished, removing anymotion trigger...\n");

    trig.type = SENSOR_TRIG_DATA_READY;
    trig.chan = SENSOR_CHAN_ACCEL_XYZ;

    if (sensor_trigger_set(dev, &trig, NULL) < 0) {
        printk("ACCEL: Cannot remove anymotion trigger.\n");
        return;
    }
}

static void test_data_ready_trigger(struct device *lis2dh)
{
    int32_t remaining_test_time = MAX_TEST_TIME;
    struct sensor_trigger trig;

    /* enable data ready trigger */
    trig.type = SENSOR_TRIG_DATA_READY;
    trig.chan = SENSOR_CHAN_ACCEL_XYZ;

    if (sensor_trigger_set(dev, &trig, trigger_handler) < 0) {
        printk("ACCEL: Cannot enable data ready trigger.\n");
        return;
    }

    printk("ACCEL: Data ready test\n");

    do {
        /* wait a while */
        k_sleep(SLEEPTIME);
        remaining_test_time -= SLEEPTIME;

    } while (remaining_test_time > 0);

    printk("ACCEL: Data ready test: finished, removing data ready trigger...\n");

    trig.type = SENSOR_TRIG_DATA_READY;
    trig.chan = SENSOR_CHAN_ACCEL_XYZ;

    if (sensor_trigger_set(dev, &trig, NULL) < 0) {
        printk("ACCEL: Cannot remove data ready trigger.\n");
        return;
    }
}

static void test_trigger_mode(struct device * dev)
{
    printk("ACCEL: %s: enter.\n", __func__);

    test_anymotion_trigger(dev);

    test_data_ready_trigger(dev);

    printk("ACCEL: %s: exit.\n", __func__);
}
#endif /* CONFIG_LIS3DH_TRIGGER */

void accel_init(void)
{
    printk("ACCEL: Binding...\n");

    dev = device_get_binding(CONFIG_LIS3DH_NAME);
    if (!dev) {
        printk("ACCEL: Device not found.\n");
        return;
    }

#if 0 //!defined(CONFIG_LIS3DH_TRIGGER)  // FIXME fix config defines
    printk("Testing the polling mode.\n");
    test_polling_mode(dev);
    printk("ACCEL: Testing the polling mode finished.\n");
#endif

#if 0 //def CONFIG_LIS3DH_TRIGGER
    //#pragma message "building LIS3DH_TRIGGER"
    printk("Testing the trigger mode.\n");
    test_trigger_mode(dev);
    printk("ACCEL: Testing the trigger mode finished.\n");
#else
    (void) test_trigger_mode;
#endif
}
```

## src/accelerometer.c
```c
/*
 *   accelerometer.c 
 */
#include <device.h>
#include <errno.h>
#include <sys/util.h>
#include <zephyr.h>
#include <drivers/sensor.h>

#include "accelerometer.h"

#define LOG_LEVEL 3
#include <logging/log.h>
LOG_MODULE_REGISTER(accel);

K_SEM_DEFINE(sem, 0, 1);

/*---------------------------------------------------------------------------*/
/*                                                                           */
/*---------------------------------------------------------------------------*/
static void trigger_handler(struct device *dev, struct sensor_trigger *trigger)
{
    ARG_UNUSED(trigger);

    if (sensor_sample_fetch(dev)) {
        LOG_ERR("sensor_sample_fetch failed");
        return;
    }

    k_sem_give(&sem);
}

/*---------------------------------------------------------------------------*/
/*                                                                           */
/*---------------------------------------------------------------------------*/
void accelerometer_init(void)
{
    struct device * dev = NULL;
    struct sensor_value accel[3];

    LOG_INF(" entry");

    dev = device_get_binding(CONFIG_LIS3DH_NAME);
    if (dev == NULL) {
        LOG_ERR("Could not get %s device", CONFIG_LIS3DH_NAME);
        return;
    }

    struct sensor_trigger trig = {
        .type = SENSOR_TRIG_THRESHOLD,
        .chan = SENSOR_CHAN_ACCEL_XYZ,
    };  

    if (IS_ENABLED(CONFIG_LIS3DH_TRIGGER)) {
        if (sensor_trigger_set(dev, &trig, trigger_handler)) {
             LOG_ERR("Could not set trigger");
            return;
        }
    }    

    while (1) {
        if (IS_ENABLED(CONFIG_LIS3DH_TRIGGER)) {
            k_sem_take(&sem, K_FOREVER);
        } else {
            if (sensor_sample_fetch(dev)) {
                 LOG_ERR("sensor_sample_fetch failed");
            }
        }

        sensor_channel_get(dev, SENSOR_CHAN_ACCEL_XYZ, accel);

         LOG_INF("AX=%10.2f AY=%10.2f AZ=%10.2f (m/s^2)",
                sensor_value_to_double(&accel[0]),
                sensor_value_to_double(&accel[1]),
                sensor_value_to_double(&accel[2]));


        if (!IS_ENABLED(CONFIG_LIS3DH_TRIGGER)) {
            k_sleep(1000);
        }
    }
}
```

## src/ble_base.c
```c
/* 
 *  ble_base.c - BLE base support 
 */

#include <zephyr/types.h>
#include <stddef.h>
#include <string.h>
#include <errno.h>
#include <sys/printk.h>
#include <sys/byteorder.h>
#include <zephyr.h>

#include <bluetooth/bluetooth.h>
#include <bluetooth/hci.h>
#include <bluetooth/conn.h>
#include <bluetooth/uuid.h>
#include <bluetooth/gatt.h>
#include <bluetooth/services/bas.h>

#include "ble_base.h"
#include "ble_policy.h"

static bool connect_state = false;

/*---------------------------------------------------------------------------*/
/*                                                                           */
/*---------------------------------------------------------------------------*/
struct bt_conn * default_conn;

static const struct bt_data advert[] = {
    BT_DATA_BYTES(BT_DATA_FLAGS, (BT_LE_AD_GENERAL | BT_LE_AD_NO_BREDR)),
    BT_DATA_BYTES(BT_DATA_UUID128_ALL,STARTER_UUID_SERVICE,STARTER_UUID_BASE)
};

/*---------------------------------------------------------------------------*/
/*                                                                           */
/*---------------------------------------------------------------------------*/
static void connected_cb(struct bt_conn * conn, u8_t err)
{
    if (err) {
        printk("Connection failed: err %u\n", err);
    }
    else {
        default_conn = bt_conn_ref(conn);

        printk("Connected\n");

        connect_state = true;
    }
}

/*---------------------------------------------------------------------------*/
/*                                                                           */
/*---------------------------------------------------------------------------*/
static void disconnected_cb(struct bt_conn * conn, u8_t reason)
{
    printk("Disconnected: reason %u\n", reason);

    if (default_conn) {
        bt_conn_unref(default_conn);
        default_conn = NULL;
    }
    connect_state = false;
}

/*---------------------------------------------------------------------------*/
/*                                                                           */
/*---------------------------------------------------------------------------*/

static struct bt_conn_cb conn_callbacks = {
    .connected = connected_cb,
    .disconnected = disconnected_cb,
};

/*---------------------------------------------------------------------------*/
/*                                                                           */
/*---------------------------------------------------------------------------*/
bool is_connected(void)
{
    return connect_state;
}

/*---------------------------------------------------------------------------*/
/*                                                                           */
/*---------------------------------------------------------------------------*/
int ble_disconnect(void)
{
    printk("%s\n", __func__);

    if (default_conn) {
        struct bt_conn * conn = default_conn;

        bt_conn_unref(default_conn);
        
        default_conn = NULL;
        
        k_sleep(50);  // wait for notifications to complete
        
        bt_conn_disconnect(conn, BT_HCI_ERR_REMOTE_USER_TERM_CONN);
    }
    return 0;
}

/*---------------------------------------------------------------------------*/
/*  Callback                                                                 */
/*---------------------------------------------------------------------------*/
static void bt_ready(int err)
{
    if (err) {
        printk("Bluetooth initialization failed: %d\n", err);
        return;
    }

    printk("Bluetooth initialized OK\n");
}

/*---------------------------------------------------------------------------*/
/*                                                                           */
/*---------------------------------------------------------------------------*/
int ble_start_advertising(void)
{
    int err;

    err = bt_le_adv_start(BT_LE_ADV_CONN_NAME, advert,
                          ARRAY_SIZE(advert), NULL, 0);
    if (err) {
        printk("Start advertising failed: %d\n", err);
        return err;
    }

    printk("Start advertising OK\n");
    return 0;
}

/*---------------------------------------------------------------------------*/
/*                                                                           */
/*---------------------------------------------------------------------------*/
int ble_stop_advertising(void)
{
    int err;

    err = bt_le_adv_stop();
    if (err) {
        printk("Stop advertising failed: %d\n", err);
        return err;
    }

    printk("Stop advertising OK\n");
    return 0;
}

/*---------------------------------------------------------------------------*/
/*                                                                           */
/*---------------------------------------------------------------------------*/
static void auth_cancel(struct bt_conn *conn)
{
    char addr[BT_ADDR_LE_STR_LEN];

    bt_addr_le_to_str(bt_conn_get_dst(conn), addr, sizeof(addr));

    printk("Pairing cancelled: %s\n", addr);
}

static struct bt_conn_auth_cb  auth_cb_display = {
    .cancel = auth_cancel,
};

/*---------------------------------------------------------------------------*/
/*                                                                           */
/*---------------------------------------------------------------------------*/
void bas_notify(void)
{
    u8_t battery_level = bt_gatt_bas_get_battery_level();

    battery_level--;

    if (!battery_level) {
        battery_level = 100U;
    }

    bt_gatt_bas_set_battery_level(battery_level);
}

/*---------------------------------------------------------------------------*/
/*                                                                           */
/*---------------------------------------------------------------------------*/
int ble_base_init(void)
{
    int err;

    err = bt_enable(bt_ready);
    if (err) {
        printk("Bluetooth initialization failed: %d\n", err);
        return err;
    }

    bt_conn_cb_register(&conn_callbacks);
    bt_conn_auth_cb_register(&auth_cb_display);

    return 0;
}
```

## src/ble_policy.c
```c
/* 
 *  ble_policy.c - BLE policy support 
 */
#include <zephyr/types.h>
#include <stddef.h>
#include <string.h>
#include <errno.h>
#include <sys/printk.h>
#include <zephyr.h>

#include "ble_base.h"
#include "ble_policy.h"

#define LOG_LEVEL 3
#include <logging/log.h>
LOG_MODULE_REGISTER(ble_policy);

/*---------------------------------------------------------------------------*/
/*                                                                           */
/*---------------------------------------------------------------------------*/
typedef struct ble_msg {
    ble_event_t event;
    u8_t        data;
} ble_msg_t;

#define QUEUE_ELEMENTS       8
#define ALIGNMENT            4  // 32-bit alignment

K_MSGQ_DEFINE(ble_queue, sizeof(ble_msg_t), QUEUE_ELEMENTS, ALIGNMENT);

/*---------------------------------------------------------------------------*/
/*                                                                           */
/*---------------------------------------------------------------------------*/
#define STACKSIZE 1024

struct k_thread ble_queue_thread;
K_THREAD_STACK_DEFINE(ble_queue_stack, STACKSIZE);

static k_tid_t tBleQ;

static bool active = false;

static struct k_work disconnect_work;

/*---------------------------------------------------------------------------*/
/*                                                                           */
/*---------------------------------------------------------------------------*/
int ble_command(u8_t command)
{
    int status = 0;

    switch (command) {

        case BLE_CMD__DISCONNECT:
            LOG_INF("%s: DISCONNECT", __func__);
            ble_disconnect();        // issue BLE disconnect
            ble_start_advertising(); // restart advertising
            status = 0;
            break;

        case BLE_CMD__CMD1:
            LOG_INF("%s: CMD1", __func__);
            // do something interesting here
            status = 0;
            break;

        case BLE_CMD__CMD2:
            LOG_INF("%s: CMD2", __func__);
            // do something interesting here
            status = 0;
            break;

        default:
            LOG_INF("%s: <unknown> %d", __func__, command);
            status = 0;
            break;
    }

    return status;
}

/*---------------------------------------------------------------------------*/
/*                                                                           */
/*---------------------------------------------------------------------------*/
static void disconnect_work_cb(struct k_work * work)
{
    ble_disconnect();
}

/*---------------------------------------------------------------------------*/
/*                                                                           */
/*---------------------------------------------------------------------------*/
void ble_policy_tasks(void)
{
    while (active) {

        k_sleep(MSEC_PER_SEC);

        if (is_connected()) {
            /* Battery level (simulation) */
            bas_notify();
        }
    }
}

/*---------------------------------------------------------------------------*/
/*                                                                           */
/*---------------------------------------------------------------------------*/
int ble_enqueue_msg(ble_event_t event, u32_t data)
{
    ble_msg_t msg;

    msg.event = event;
    msg.data = data;

    while (k_msgq_put(&ble_queue, &msg, K_NO_WAIT) != 0) {
        LOG_ERR("%s: k_msgq_put error: purging queue", __func__);
        k_msgq_purge(&ble_queue);
        return -EIO;
    }
    return 0;
}

/*---------------------------------------------------------------------------*/
/*                                                                           */
/*---------------------------------------------------------------------------*/
static void ble_queue_service(void)
{
    int status;
    ble_msg_t msg;
    
    printk("%s: started\n", __func__);

    while (1) {

        k_msgq_get(&ble_queue, &msg, K_FOREVER);

        switch (msg.event) {

            case BLE_EVENT__COMMAND:
                status = ble_command(msg.data);
                ble_operation_complete(msg.event, status);
                break;

            default:
                ble_operation_complete(msg.event, -EIO);
                break;
        }
    }
}

/*---------------------------------------------------------------------------*/
/*                                                                           */
/*---------------------------------------------------------------------------*/
static int ble_queue_init(void)
{
    int status = 0;

    tBleQ = k_thread_create(&ble_queue_thread, 
                            ble_queue_stack, STACKSIZE,
                            (k_thread_entry_t)ble_queue_service, 
                            NULL, NULL, NULL, -1, K_USER, K_FOREVER);

    k_thread_start(&ble_queue_thread);

    return status;
}

/*---------------------------------------------------------------------------*/
/*                                                                           */
/*---------------------------------------------------------------------------*/
void ble_operation_complete(ble_event_t event, u32_t code)
{
    starter_notify(event, code);
}

/*---------------------------------------------------------------------------*/
/*                                                                           */
/*---------------------------------------------------------------------------*/
int ble_policy_init(void)
{
    int status;

    /*
     *  Start base BLE 
     */
    status = ble_base_init();
    if (status < 0) {
        return status;
    }

    /*
     *  Start Advertising:  FIXME  change on-demand started later.
     */
    status = ble_start_advertising();
    if (status < 0) {
        return status;
    }

    /*
     *  Start queue service on its own thread.
     */
    ble_queue_init();
    if (status < 0) {
        return status;
    }

    disconnect_work.handler = disconnect_work_cb;

    /*
     *  Indicate all is initialized.
     */
    active = true;

    /* 
     *  Start polling tasks: thread should never return. Keep last.
     */
    ble_policy_tasks();

    return -EINVAL;
}
```

## src/ble_service.c
```c
/*
 *  BLE Service
 */
#include <zephyr/types.h>
#include <stddef.h>
#include <string.h>
#include <errno.h>
#include <zephyr.h>
#include <init.h>

#include <bluetooth/bluetooth.h>
#include <bluetooth/hci.h>
#include <bluetooth/conn.h>
#include <bluetooth/uuid.h>
#include <bluetooth/gatt.h>

#include "ble_policy.h"
#include "ble_uuids.h"
#include "ble_service.h"

#define LOG_LEVEL 3 //CONFIG_LOG_DEFAULT_LEVEL
#include <logging/log.h>
LOG_MODULE_REGISTER(starter_ble);

/*---------------------------------------------------------------------------*/
/*                                                                           */
/*---------------------------------------------------------------------------*/
#define CPF_FORMAT_UINT8    4
#define CPF_FORMAT_UTF8     25
#define CPF_FORMAT_OPAQUE   27

static const struct bt_gatt_cpf command_cpf = {
  .format      = CPF_FORMAT_UINT8,
  .exponent    = 0,         // no fix-point exponent
  .unit        = 0x2700,    // unitless
  .name_space  = 0x01,      // Bluetoot SIG assigned
  .description = 0x0100,    // Front
};

/*---------------------------------------------------------------------------*/
/*                                                                           */
/*---------------------------------------------------------------------------*/

static u8_t starter_command[] = {
    0x00,
};

/*---------------------------------------------------------------------------*/
/*                                                                           */
/*---------------------------------------------------------------------------*/
static ssize_t starter_read_command(struct bt_conn * conn,
                                 const struct bt_gatt_attr * attr,
                                 void * buf,
                                 u16_t len,
                                 u16_t offset)
{
    const char * value = attr->user_data;

    return bt_gatt_attr_read(conn, attr, buf, len, offset, value,
                             sizeof(starter_command));
}

/*---------------------------------------------------------------------------*/
/*                                                                           */
/*---------------------------------------------------------------------------*/
static ssize_t starter_write_command(struct bt_conn * conn,
                                  const struct bt_gatt_attr *attr,
                                  const void * buf,
                                  u16_t len,
                                  u16_t offset,
                                  u8_t flags)
{
    u8_t * data = attr->user_data;

    //LOG_INF("%s: %02x", __func__, *data);

    if (len != 1) {
        LOG_ERR("%s: INVALID_LENGTH", __func__);
        return BT_GATT_ERR(BT_ATT_ERR_INVALID_ATTRIBUTE_LEN);
    }

    ble_enqueue_msg(BLE_EVENT__COMMAND, *(u32_t*)buf);

    if (flags & BT_GATT_WRITE_FLAG_PREPARE) {
        LOG_INF("%s: WRITE_FLAG_PREPARE", __func__);
        return 0;
    }

    if (offset + len > sizeof(starter_command)) {
        LOG_ERR("%s: INVALID_OFFSET", __func__);
        return BT_GATT_ERR(BT_ATT_ERR_INVALID_OFFSET);
    }

    memcpy(data + offset, buf, len);

    return len;
}

/*---------------------------------------------------------------------------*/
/*                                                                           */
/*---------------------------------------------------------------------------*/
static void starter_ccc_cfg_changed(const struct bt_gatt_attr * attr, u16_t value)
{
  bool notif_enabled = (value == BT_GATT_CCC_NOTIFY);

  LOG_INF("STARTER notifications %s", notif_enabled ? "enabled" : "disabled");
}

/*---------------------------------------------------------------------------*/
/* STARTER Service Declaration                                                  */
/*---------------------------------------------------------------------------*/
BT_GATT_SERVICE_DEFINE(starter_svc,
    BT_GATT_PRIMARY_SERVICE(BT_UUID_STARTER_SERVICE),
    BT_GATT_CHARACTERISTIC(BT_UUID_STARTER_NOTIFY, BT_GATT_CHRC_NOTIFY,
    BT_GATT_PERM_NONE, NULL, NULL, NULL),
    BT_GATT_CCC(starter_ccc_cfg_changed, BT_GATT_PERM_READ | BT_GATT_PERM_WRITE),
    BT_GATT_CHARACTERISTIC(BT_UUID_STARTER_COMMAND,
        (BT_GATT_CHRC_READ | BT_GATT_CHRC_WRITE | BT_GATT_CHRC_EXT_PROP),
        (BT_GATT_PERM_READ | BT_GATT_PERM_WRITE | BT_GATT_PERM_PREPARE_WRITE),
        starter_read_command, starter_write_command, &starter_command),
    BT_GATT_CUD("Command", BT_GATT_PERM_READ),
    BT_GATT_CPF(&command_cpf),
);

/*---------------------------------------------------------------------------*/
/*                                                                           */
/*---------------------------------------------------------------------------*/
int starter_notify(u32_t cmd, u32_t code)
{
    struct {
        u32_t cmd;
        u32_t code;
    } data;

    data.cmd = cmd;
    data.code = code;

    if (is_connected()) {
        int rc = bt_gatt_notify(NULL, &starter_svc.attrs[1], &data, sizeof(data));
        return rc;
    }
    else {
        return -ENOTCONN;
    }
}
```
